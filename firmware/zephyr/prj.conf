## CMakeLists.txt
```
# © 2026 Unit Circle Inc.
# SPDX-License-Identifier: Apache-2.0
#
# The test firmware (../app) on Zephyr 4.x, with the ucLog device library as a Zephyr module
# (../../device) and ucComm. See README.md.

cmake_minimum_required(VERSION 3.20.0)
# Always, besides any boards/<board>.overlay (which picks the ucLog link).
list(APPEND EXTRA_DTC_OVERLAY_FILE ${CMAKE_CURRENT_SOURCE_DIR}/logdata.overlay)
find_package(Zephyr REQUIRED HINTS $ENV{ZEPHYR_BASE})
project(uclog_test)

cmake_path(SET APP_DIR NORMALIZE ${CMAKE_CURRENT_SOURCE_DIR}/../app) # normalised: the prefix map below matches it
target_sources(app PRIVATE
  ${APP_DIR}/main.c
  ${APP_DIR}/bench.c
  ${APP_DIR}/drivers/sensor.c
  ${APP_DIR}/sh/semihost_test.c
  src/board.c
)
target_include_directories(app PRIVATE ${APP_DIR} src)
# Logs (and {sym}, from the DWARF) name the shared app's files src/... as on the bare-metal boards.
target_compile_options(app PRIVATE -ffile-prefix-map=${APP_DIR}/=src/ -ffile-prefix-map=${CMAKE_CURRENT_SOURCE_DIR}/src/=board/)
# The shared app logs floats on purpose (they are promoted to double, as the test expects).
set_source_files_properties(${APP_DIR}/main.c ${APP_DIR}/bench.c ${APP_DIR}/drivers/sensor.c
  PROPERTIES COMPILE_OPTIONS -Wno-double-promotion)
```

## prj.conf
```kconfig
# ucLog on the devicetree's uclog,link (boards/*.overlay), with semihost.
CONFIG_UC_LOG=y
CONFIG_UC_SYSCALLS=y
# Zephyr's LOG_INF and friends as ucLog logs; no Zephyr log backends or console.
CONFIG_LOG=y
CONFIG_LOG_MODE_MINIMAL=y
CONFIG_LOG_CUSTOM_HEADER=y
CONFIG_CONSOLE=n
CONFIG_UART_CONSOLE=n
CONFIG_BOOT_BANNER=n

# The test app: printf with floats, POSIX files (on the semihost file system), the LED, the UID.
CONFIG_PICOLIBC_IO_FLOAT=y
CONFIG_POSIX_API=y
# File descriptors: stdin, stdout, stderr and the selftest's files.
CONFIG_ZVFS_OPEN_ADD_SIZE_POSIX=8
CONFIG_GPIO=y
CONFIG_HWINFO=y
CONFIG_FPU=y
CONFIG_MAIN_STACK_SIZE=4096
```

## logdata.overlay
```dts
/* The non-loaded region the log format strings are placed in (log.ld). Its address gives the
 * target digit: (address >> 20) & 0xF = 0, as on the bare-metal boards. */
/ {
	logdata: memory@f0000000 {
		compatible = "zephyr,memory-region";
		reg = <0xf0000000 0x100000>;
		status = "okay";
		zephyr,memory-region = "LOGDATA";
	};
};
```

## src/board.c
```c
// © 2026 Unit Circle Inc.
// SPDX-License-Identifier: Apache-2.0

#include "board.h"

#include <zephyr/drivers/gpio.h>
#include <zephyr/drivers/hwinfo.h>
#include <zephyr/kernel.h>

static const struct gpio_dt_spec led = GPIO_DT_SPEC_GET_OR(DT_ALIAS(led0), gpios, {0});
static bool led_on;

void board_init(void) {
  if (led.port != NULL && gpio_is_ready_dt(&led)) gpio_pin_configure_dt(&led, GPIO_OUTPUT_INACTIVE);
}

void board_led(bool on) {
  led_on = on;
  if (led.port != NULL) gpio_pin_set_dt(&led, on);
}

void board_led_toggle(void) {
  board_led(!led_on);
}

uint32_t board_cycles(void) {
  return k_cycle_get_32(); // the system timer's cycles: the CPU clock with the Cortex-M SysTick
}

uint32_t board_hz(void) {
  return sys_clock_hw_cycles_per_sec();
}

uint32_t board_ms(void) {
  return k_uptime_get_32();
}

void board_delay_ms(uint32_t d) {
  k_msleep(d);
}

const uint8_t *board_uid(void) {
  static uint8_t uid[12];
  (void)hwinfo_get_device_id(uid, sizeof(uid));
  return uid;
}
```

## src/board.h
```c
// © 2026 Unit Circle Inc.
// SPDX-License-Identifier: Apache-2.0
//
// The test app's board interface (../app) on Zephyr.

#pragma once

#include <stdbool.h>
#include <stdint.h>

#define BOARD_NAME CONFIG_BOARD

void board_init(void);
void board_led(bool on);
void board_led_toggle(void);
uint32_t board_ms(void);
void board_delay_ms(uint32_t d);
const uint8_t *board_uid(void); // 12 bytes
uint32_t board_cycles(void);    // a CPU cycle counter (wraps), for timing short stretches of code
uint32_t board_hz(void);        // CPU cycles per second
```
