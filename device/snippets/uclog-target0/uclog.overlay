
#define UC_LOG_TARGET (0)

/ {
    logdata: memory@f0000000 {
        compatible = "zephyr,memory-region";
        reg = <(0xf0000000+0x0100000*UC_LOG_TARGET) 0x0100000>;
        status = "okay";
        zephyr,memory-region = "LOGDATA";
    };
};


