## device/Kconfig
```kconfig
# © 2025 Unit Circle Inc.
# SPDX-License-Identifier: Apache-2.0

rsource "drivers/Kconfig"
rsource "lib/Kconfig"
```

## device/dts/bindings/unitcircle,ucusb.yaml
```yaml
description: |
  Unit Circle USB

  This is the binding for the peripheral USBD the driver implements the
  CDC?ACM serial profile with a different API from standard Zephyr serial API.    The new API matches needs of Unit Circle Logging Framwork.

compatible: "unitcircle,ucusb"

include: usb-ep.yaml

properties:
    reg:
      required: true

    interrupts:
      required: true

    num-isoin-endpoints:
      type: int
      required: true
      description: Number of ISOIN endpoints supported by hardware

    num-isoout-endpoints:
      type: int
      required: true
      description: Number of ISOOUT endpoints supported by hardware
```

## drivers/Kconfig
```kconfig
# © 2025 Unit Circle Inc.
# SPDX-License-Identifier: Apache-2.0

menu "UC Drivers"
rsource "ucuart/Kconfig"
rsource "ucusb/Kconfig"
endmenu
```

## drivers/ucuart/Kconfig
```kconfig
# © 2025 Unit Circle Inc.
# SPDX-License-Identifier: Apache-2.0

config UCUART
	bool "Unit Circle UART"
	default y
	depends on DT_HAS_UNITCIRCLE_UCUART_ENABLED
	select EVENTS
	select NRFX_PPI
	select PINCTRL
	select NRFX_TIMER4
	help
	  Unit Circle UART

if UCUART

config UCUART_INIT_PRIORITY
	int "ucuart init priority"
	default 90 # KERNEL_INIT_PRIORITY_DEVICE
	help
	  Unit Circle UART initialization priority.

# Can include specific alternatives here e.g.
# rsource Kconfig.xxx

endif
```

## drivers/ucusb/Kconfig
```kconfig
# © 2022 Unit Circle Inc.
# SPDX-License-Identifier: Apache-2.0

config UCUSB
	bool "Unit Circle USB Serial"
	default y
	depends on DT_HAS_UNITCIRCLE_UCUSB_ENABLED
	select EVENTS
	select NRF_USBD_COMMON
	select NRFX_POWER
	help
	  Unit Circle USB Serial

if UCUSB

config UCUSB_INIT_PRIORITY
	int "ucusb init priority"
	default 90 # KERNEL_INIT_PRIORITY_DEVICE
	help
	  Unit Circle USB initialization priority.

endif
```

## west.yml
```yaml
# © 2025 Unit Circle Inc

manifest:
  defaults:
    revision: main

  self:
    path: newlog
    west-commands: scripts/west-commands.yml

  remotes:
    - name: ncs
      url-base: https://github.com/nrfconnect
    - name: uci
      url-base: https://github.com/UnitCircleInc

  projects:
    - name: nrf
      remote: ncs
      repo-path: sdk-nrf
      revision: v2.9.0
      import: true
      import:
        name-allowlist:
          - zephyr
          - nrfxlib
          - cmock
          - cmsis
          - hal_nordic
          - segger
          - tinycrypt

    - name: uccomm
      remote: uci
      revision: v2
      repo-path: ucComm
      path: modules/uccomm
```
