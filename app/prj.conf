## CMakeLists.txt
```
# © 2025 Unit Circle Inc

cmake_minimum_required(VERSION 3.20.0)



# TODO This can go in modules.yml when I convert to module
# See: https://docs.zephyrproject.org/latest/build/snippets/writing.html#where-snippets-are-located
set(SNIPPET_ROOT ../lib ${SNIPPET_ROOT} CACHE STRING "" FORCE)

# west build -S uclog-target1
# Or we can force
# See: https://docs.zephyrproject.org/latest/build/snippets/using.html#application-required-snippets
if(NOT uclog-target1 IN_LIST SNIPPET)
  set(SNIPPET uclog-target1 ${SNIPPET} CACHE STRING "" FORCE)
endif()


find_package(Zephyr REQUIRED HINTS $ENV{ZEPHYR_BASE})

zephyr_compile_options( -Werror )

project(app)

target_sources(app PRIVATE src/main.c
)
```

## prj.conf
```kconfig
CONFIG_FPU=y
CONFIG_TIMING_FUNCTIONS=y
CONFIG_STACK_USAGE=y

CONFIG_LOG_DEFAULT_LEVEL=4

CONFIG_KERNEL_LOG_LEVEL_WRN=y
CONFIG_MPU_LOG_LEVEL_WRN=y
CONFIG_CLOCK_CONTROL_LOG_LEVEL_WRN=y

CONFIG_NCS_BOOT_BANNER=n
CONFIG_BOOT_BANNER=n
#CONFIG_PRINTK=n
```

## nrf52840dk_nrf52840.overlay
```dts
&uart0 {
    compatible = "unitcircle,ucuart";
    current-speed = <1000000>;
    /* pinctrl-0 = <&uart0_default>; */
    /* pinctrl-1 = <&uart0_sleep>; */
    /* pinctrl-names = "default", "sleep"; */
    /* status = "okay"; */
};
```

## src/main.c
```c
// © 2025 Unit Circle Inc.`

#include <stdlib.h>
#include <stdint.h>
#include "zephyr/kernel.h"
#include "zephyr/logging/log.h"
#include "zephyr/logging/log_output.h"
#include "zephyr/timing/timing.h"

#include <stdarg.h>

LOG_MODULE_REGISTER(main);

void my_work_handler(struct k_work *work) {
  //int64_t now = k_uptime_get();
  //double  secs = (float) now / 1000.0f;
  static uint32_t x  = 0;
  x = x + 1;
  timing_start();
  timing_t start = timing_counter_get();
  //LOG_INF("tick %.3f s since reset", secs);
  //LOG_INF("tick %lld s since reset", now);
  //LOG_INF("tick 00000 s since reset");
  LOG_INF("tick %u since reset", x);
  timing_t end = timing_counter_get();
  timing_stop();
  uint64_t cycles = timing_cycles_get(&start, &end);
  uint64_t ns     = timing_cycles_to_ns(cycles);
  LOG_INF("timing %lld cycles %lld ns", cycles, ns);
}

K_WORK_DEFINE(my_work, my_work_handler);

void my_timer_handler(struct k_timer *dummy) {
    k_work_submit(&my_work);
}

K_TIMER_DEFINE(my_timer, my_timer_handler, NULL);

int main(void) {
    //log_output_timestamp_freq_set(0); // Disable generating timestamps
  LOG_ERR("error");
  LOG_WRN("warn");
  LOG_INF("info");
  LOG_DBG("debug");
  printk("xxx %s %d\n", "hello", 2);
  LOG_PRINTK("hello\n"); // calls Z_LOG_PRINTK - can easily fake it
  timing_init();
  (void) k_timer_start(&my_timer, K_SECONDS(5), K_SECONDS(5));

  while (true) {
    (void) k_sleep(K_MSEC(1000));
    //boot_banner();
    LOG_DBG("debug");
    LOG_DEBUG("%s", "hello there");

  }
}




//----------------

#if 0

static void uc_console_hook_install(void)
{
#if defined(CONFIG_STDOUT_CONSOLE)
        __stdout_hook_install(console_out);
#endif
#if defined(CONFIG_PRINTK)
        __printk_hook_install(console_out);
#endif
}

/**
 * @brief Initialize one UART as the console/debug port
 *
 * @return 0 if successful, otherwise failed.
 */
static int uc_console_init(void)
{
        if (!device_is_ready(uart_console_dev)) {
                return -ENODEV;
        }

        uart_console_hook_install();

        return 0;
}

/* UART console initializes after the UART device itself */
SYS_INIT(uc_console_init,
#if defined(CONFIG_EARLY_CONSOLE)
         PRE_KERNEL_1,
#else
         POST_KERNEL,
#endif
         CONFIG_CONSOLE_INIT_PRIORITY);

#endif
```
